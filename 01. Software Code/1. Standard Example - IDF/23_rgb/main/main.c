/**
 ******************************************************************************************************************************************************************************************************************************************************************************************************************************************************************************************************************************************************************************************************************************************************************************************************************************************************************************************************************************************************************************************
 * @file main.c
 * @author
 * @version V1.0
 * @date 2023-08-26
 * @brief LTDC experiment
 * @license Copyright (c) 2020-2032,
 ******************************************************************************************************************************************************************************************************************************************************************************************************************************************************************************************************************************************************************************************************************************************************************************************************************************************************************************************************************************************************************************************
 * @attention

 ******************************************************************************************************************************************************************************************************************************************************************************************************************************************************************************************************************************************************************************************************************************************************************************************************************************************************************************************************************************************************************************************
 */

#include <stdio.h>
#include <stdlib.h>
#include <string.h>
#include "freertos/FreeRTOS.h"
#include "freertos/task.h"
#include "esp_system.h"
#include "nvs_flash.h"
#include "led.h"
#include "ltdc.h"

i2c_obj_t i2c0_master;

/**
 * @brief       Program entry
 * @param       none
 * @retval      none
 */
void app_main(void)
{
    uint8_t x = 0;
    uint8_t lcd_id[12];
    esp_err_t ret;
    
    ret = nvs_flash_init();                                             /* Initialize NVS */

    if (ret == ESP_ERR_NVS_NO_FREE_PAGES || ret == ESP_ERR_NVS_NEW_VERSION_FOUND)
    {
        ESP_ERROR_CHECK(nvs_flash_erase());
        ret = nvs_flash_init();
    }

    led_init();                                                         /* initializationLED */
    i2c0_master = iic_init(I2C_NUM_0);                                  /* initializationIIC0 */
    xl9555_init(i2c0_master);                                           /* IO expansion chip initialization */
    ltdc_init();                                                        /* RGB screen initialization */

    sprintf((char *)lcd_id, "LCD ID:%04X", ltdcdev.id);                 /* Print LCD ID to lcd_id array */

    while (1)
    {
        switch (x)
        {
            case 0:
                ltdc_clear(WHITE);
                break;

            case 1:
                ltdc_clear(BLACK);
                break;

            case 2:
                ltdc_clear(BLUE);
                break;

            case 3:
                ltdc_clear(RED);
                break;

            case 4:
                ltdc_clear(MAGENTA);
                break;

            case 5:
                ltdc_clear(GREEN);
                break;

            case 6:
                ltdc_clear(CYAN);
                break;

            case 7:
                ltdc_clear(YELLOW);
                break;
        }

        ltdc_show_string(10, 40, 240, 32, 32, "ESP32S3", RED);
        ltdc_show_string(10, 80, 240, 24, 24, "LTDC TEST", RED);
        ltdc_show_string(10, 110, 240, 16, 16, "ATOM@ALIENTEK", RED);
        ltdc_show_string(10, 130, 240, 16, 16, (char *)lcd_id, RED);    /* Display LCD ID */

        x++;

        if (x == 8)
        {
            x = 0;
        }

        vTaskDelay(1000);
    }
}